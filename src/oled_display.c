/**
 * @file oled_display.c
 * @brief OLED display driver implementation using SSD1306
 */

#include "oled_display.h"
#include <string.h>
#include "driver/i2c.h"
#include "esp_log.h"

static const char *TAG = "OLED";

// I2C configuration
#define I2C_MASTER_NUM      I2C_NUM_0
#define I2C_MASTER_SDA_IO   5
#define I2C_MASTER_SCL_IO   6
#define I2C_MASTER_FREQ_HZ  400000

// SSD1306 configuration
#define OLED_I2C_ADDRESS    0x3C
#define OLED_WIDTH          128
#define OLED_HEIGHT         32
#define OLED_PAGES          (OLED_HEIGHT / 8)

// SSD1306 commands
#define OLED_CMD_DISPLAY_OFF            0xAE
#define OLED_CMD_DISPLAY_ON             0xAF
#define OLED_CMD_SET_CONTRAST           0x81
#define OLED_CMD_SET_DISPLAY_NORMAL     0xA6
#define OLED_CMD_SET_DISPLAY_INVERSE    0xA7
#define OLED_CMD_SET_MULTIPLEX_RATIO    0xA8
#define OLED_CMD_SET_DISPLAY_OFFSET     0xD3
#define OLED_CMD_SET_START_LINE         0x40
#define OLED_CMD_SET_SEGMENT_REMAP      0xA1
#define OLED_CMD_SET_COM_SCAN_DEC       0xC8
#define OLED_CMD_SET_COM_PINS           0xDA
#define OLED_CMD_SET_DISPLAY_CLK_DIV    0xD5
#define OLED_CMD_SET_PRECHARGE          0xD9
#define OLED_CMD_SET_VCOM_DESELECT      0xDB
#define OLED_CMD_CHARGE_PUMP            0x8D
#define OLED_CMD_SET_MEMORY_MODE        0x20
#define OLED_CMD_SET_COLUMN_ADDR        0x21
#define OLED_CMD_SET_PAGE_ADDR          0x22

// Display buffer
static uint8_t display_buffer[OLED_WIDTH * OLED_PAGES] = {0};

// Simple 5x8 font (ASCII 32-127)
static const uint8_t font5x8[][5] = {
    {0x00, 0x00, 0x00, 0x00, 0x00}, // space
    {0x00, 0x00, 0x5F, 0x00, 0x00}, // !
    {0x00, 0x07, 0x00, 0x07, 0x00}, // "
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    {0x44, 0x64, 0x54, 0x4C, 0x44}, // z
};

/**
 * @brief Write command to OLED
 */
static esp_err_t oled_write_command(uint8_t cmd)
{
    uint8_t data[2] = {0x00, cmd};
    return i2c_master_write_to_device(I2C_MASTER_NUM, OLED_I2C_ADDRESS, data, 2, pdMS_TO_TICKS(1000));
}

/**
 * @brief Write data to OLED
 */
static esp_err_t oled_write_data(uint8_t *data, size_t len)
{
    // Use fixed buffer to avoid VLA and stack overflow
    #define OLED_WRITE_BUFFER_SIZE 129  // 1 byte control + 128 bytes data max
    static uint8_t buffer[OLED_WRITE_BUFFER_SIZE];
    
    if (len >= OLED_WRITE_BUFFER_SIZE) {
        ESP_LOGE(TAG, "Data too large for OLED write buffer");
        return ESP_ERR_INVALID_SIZE;
    }
    
    buffer[0] = 0x40;
    memcpy(buffer + 1, data, len);
    return i2c_master_write_to_device(I2C_MASTER_NUM, OLED_I2C_ADDRESS, buffer, len + 1, pdMS_TO_TICKS(1000));
}

void oled_init(void)
{
    ESP_LOGI(TAG, "Initializing OLED display...");
    
    // Configure I2C
    i2c_config_t conf = {
        .mode = I2C_MODE_MASTER,
        .sda_io_num = I2C_MASTER_SDA_IO,
        .scl_io_num = I2C_MASTER_SCL_IO,
        .sda_pullup_en = GPIO_PULLUP_ENABLE,
        .scl_pullup_en = GPIO_PULLUP_ENABLE,
        .master.clk_speed = I2C_MASTER_FREQ_HZ,
    };
    
    ESP_ERROR_CHECK(i2c_param_config(I2C_MASTER_NUM, &conf));
    ESP_ERROR_CHECK(i2c_driver_install(I2C_MASTER_NUM, conf.mode, 0, 0, 0));
    
    // Initialize SSD1306
    vTaskDelay(pdMS_TO_TICKS(100));
    
    oled_write_command(OLED_CMD_DISPLAY_OFF);
    oled_write_command(OLED_CMD_SET_DISPLAY_CLK_DIV);
    oled_write_command(0x80);
    oled_write_command(OLED_CMD_SET_MULTIPLEX_RATIO);
    oled_write_command(0x1F); // 32 rows
    oled_write_command(OLED_CMD_SET_DISPLAY_OFFSET);
    oled_write_command(0x00);
    oled_write_command(OLED_CMD_SET_START_LINE | 0x00);
    oled_write_command(OLED_CMD_CHARGE_PUMP);
    oled_write_command(0x14);
    oled_write_command(OLED_CMD_SET_MEMORY_MODE);
    oled_write_command(0x00); // Horizontal addressing mode
    oled_write_command(OLED_CMD_SET_SEGMENT_REMAP);
    oled_write_command(OLED_CMD_SET_COM_SCAN_DEC);
    oled_write_command(OLED_CMD_SET_COM_PINS);
    oled_write_command(0x02);
    oled_write_command(OLED_CMD_SET_CONTRAST);
    oled_write_command(0x8F);
    oled_write_command(OLED_CMD_SET_PRECHARGE);
    oled_write_command(0xF1);
    oled_write_command(OLED_CMD_SET_VCOM_DESELECT);
    oled_write_command(0x40);
    oled_write_command(OLED_CMD_SET_DISPLAY_NORMAL);
    oled_write_command(OLED_CMD_DISPLAY_ON);
    
    oled_clear();
    
    ESP_LOGI(TAG, "OLED display initialized");
}

void oled_clear(void)
{
    memset(display_buffer, 0, sizeof(display_buffer));
    
    oled_write_command(OLED_CMD_SET_COLUMN_ADDR);
    oled_write_command(0);
    oled_write_command(OLED_WIDTH - 1);
    
    oled_write_command(OLED_CMD_SET_PAGE_ADDR);
    oled_write_command(0);
    oled_write_command(OLED_PAGES - 1);
    
    oled_write_data(display_buffer, sizeof(display_buffer));
}

void oled_display_text(uint8_t line, const char *text, uint8_t invert)
{
    if (line >= OLED_PAGES) return;
    
    uint8_t x = 0;
    uint8_t page = line;
    
    // Clear line first
    for (int i = 0; i < OLED_WIDTH; i++) {
        display_buffer[page * OLED_WIDTH + i] = 0;
    }
    
    // Draw text
    while (*text && x < OLED_WIDTH - 5) {
        uint8_t c = *text;
        if (c >= 32 && c <= 122) {
            const uint8_t *glyph = font5x8[c - 32];
            for (int i = 0; i < 5; i++) {
                uint8_t pixel_data = glyph[i];
                if (invert) {
                    pixel_data = ~pixel_data;
                }
                display_buffer[page * OLED_WIDTH + x++] = pixel_data;
            }
            x++; // Space between characters
        }
        text++;
    }
    
    // Update display
    oled_write_command(OLED_CMD_SET_COLUMN_ADDR);
    oled_write_command(0);
    oled_write_command(OLED_WIDTH - 1);
    
    oled_write_command(OLED_CMD_SET_PAGE_ADDR);
    oled_write_command(page);
    oled_write_command(page);
    
    oled_write_data(&display_buffer[page * OLED_WIDTH], OLED_WIDTH);
}
